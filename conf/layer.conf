## conf/layer.conf
```bitbake
# We have a conf and classes directory, add to BBPATH
BBPATH .= ":${LAYERDIR}"

# We have recipes-* directories, add to BBFILES
BBFILES += "${LAYERDIR}/recipes-*/*/*.bb \
            ${LAYERDIR}/recipes-*/*/*.bbappend"

BBFILE_COLLECTIONS += "meta-swid-7"
BBFILE_PATTERN_meta-swid-7 = "^${LAYERDIR}/"
BBFILE_PRIORITY_meta-swid-7 = "20"

LAYERDEPENDS_meta-swid-7 = "phytec"
LAYERSERIES_COMPAT_meta-swid-7 = "scarthgap"
```
